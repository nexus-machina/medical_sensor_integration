## prj.conf
```kconfig
# Enable the shell and its serial backend
CONFIG_SHELL=y

# Enable the I2C driver and the I2C shell commands
CONFIG_I2C=y
CONFIG_I2C_SHELL=y
```

## boards/esp32s3_touch_lcd_1_28_esp32s3_procpu.overlay
```dts
#include <dt-bindings/pinctrl/esp32s3-pinctrl.h>
#include <zephyr/dt-bindings/i2c/i2c.h> // Include I2C timing defines

&pinctrl {
  i2c0_default: i2c0_default {
    group1 {
      pinmux = <I2C0_SDA_GPIO15>, <I2C0_SCL_GPIO16>;
      bias-pull-up;
      drive-open-drain;
      output-high;
    };
  };
};

&i2c0 {
  status = "okay";
  pinctrl-0 = <&i2c0_default>; // Assign our custom pin configuration
  pinctrl-names = "default";       // Use this pin configuration by default
  clock-frequency = <I2C_BITRATE_STANDARD>;
};
```

## src/main.c
```c
/*
 * Copyright (c) 2025 Nexus Machina LLC
 */

#include <zephyr/kernel.h>

int main(void)
{
  printk("Enter Zephyr Shell\n");
  return 0;
}
```
